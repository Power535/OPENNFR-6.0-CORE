## meta-oe-alliance/meta-brands/meta-entwopia/conf/machine/ew7362.conf
```bitbake
#@TYPE: Machine
#@NAME: ENTWOPIA EW7358
#@DESCRIPTION: Machine configuration for the ENTWOPIA EW7362

SOC_FAMILY = "bcm7362"

MACHINE_FEATURES += " videoenhancement"

PREFERRED_VERSION_linux-entwopia = "4.0.1"
PREFERRED_VERSION_linux-libc-headers = "4.0"

require conf/machine/include/entwopia-oem.inc

EXTRA_IMAGEDEPENDS += "\
    enigma2-plugin-systemplugins-vfdcontrol \
    "

MACHINE_EXTRA_RDEPENDS = "\
    enigma2-plugin-systemplugins-vfdcontrol \
    "
```
